## base_external/package/aesd-assignments/Config.in
```kconfig
config BR2_PACKAGE_AESD_ASSIGNMENTS
	bool "aesd-assignments"
	help
	  Builds and installs the AESD finder application (writer, finder.sh,
	  finder-test.sh) from the assignments-3-and-later git repository.
```
